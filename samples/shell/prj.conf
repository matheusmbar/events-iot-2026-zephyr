## sample.yaml
```
sample:
  name: Shell sample
tests:
  events-iot-2026.sample.shell:
    build_only: true
    tags:
      - LED
      - gpio
      - SPI
      - I2C
    integration_platforms:
      - native_sim/native
      - frdm_mcxa156
      - frdm_k82f
      - stm32f4_disco
      - nucleo_f302r8
      - iot_2026_mcxa156
```

## prj.conf
```kconfig
# Generic
CONFIG_LOG=y
CONFIG_REBOOT=y

# Peripherals
CONFIG_ADC=y
CONFIG_GPIO=y
CONFIG_INPUT=y
CONFIG_LED=y
CONFIG_I2C=y
CONFIG_I3C=y
CONFIG_SENSOR=y
CONFIG_SPI=y

# Networking
CONFIG_NETWORKING=y
CONFIG_NET_IPV4=y
CONFIG_NET_STATISTICS=y
CONFIG_NET_CONFIG_SETTINGS=y
CONFIG_NET_CONFIG_MY_IPV4_ADDR="192.0.2.1"

# Shell
CONFIG_SHELL=y
CONFIG_SHELL_PROMPT_UART="iot-2026:~$ "
CONFIG_ADC_SHELL=y
CONFIG_GPIO_SHELL=y
CONFIG_INPUT_SHELL=y
CONFIG_LED_SHELL=y
CONFIG_I2C_SHELL=y
CONFIG_I3C_SHELL=y
CONFIG_SENSOR_SHELL=y
CONFIG_SENSOR_SHELL_STREAM=y
CONFIG_SPI_SHELL=y
CONFIG_NET_SHELL=y
```

## boards/native_sim.conf
```kconfig
# Emulation
CONFIG_EMUL=y
CONFIG_GPIO_EMUL=y
CONFIG_I2C_EMUL=y
CONFIG_SPI_EMUL=y
```

## boards/nucleo_f302r8.conf
```kconfig
CONFIG_ENTROPY_GENERATOR=y
CONFIG_TEST_RANDOM_GENERATOR=y

CONFIG_SHELL=y

CONFIG_NETWORKING=n

CONFIG_I3C=n
CONFIG_I2C=n
CONFIG_SPI=n
CONFIG_ADC=n
CONFIG_DAC=n

CONFIG_ADC_SHELL=n
CONFIG_GPIO_SHELL=n
CONFIG_INPUT_SHELL=n
CONFIG_LED_SHELL=n
CONFIG_I2C_SHELL=n
CONFIG_I3C_SHELL=n
CONFIG_SENSOR_SHELL=n
CONFIG_SENSOR_SHELL_STREAM=n
CONFIG_SPI_SHELL=n
CONFIG_NET_SHELL=n
```

## boards/stm32f4_disco.conf
```kconfig
CONFIG_ENTROPY_GENERATOR=y
CONFIG_TEST_RANDOM_GENERATOR=y
```

## src/main.c
```c
#include <zephyr/logging/log.h>

LOG_MODULE_REGISTER(main);

int main() {
  LOG_INF("Hello from %s", CONFIG_BOARD);
  return 0;
}
```
