## boards/iot_2026_mcxa156/board.yml
```yaml
board:
  name: iot_2026_mcxa156
  full_name: IoT 2026 - FRDM-MCXA156
  vendor: nxp
  socs:
  - name: mcxa156
```

## manifest/boards/iot_2026_mcxa156/Kconfig.iot_2026_mcxa156
```kconfig
# Copyright 2024 NXP
# SPDX-License-Identifier: Apache-2.0

config BOARD_IOT_2026_MCXA156
	select SOC_MCXA156 if BOARD_IOT_2026_MCXA156
	select SOC_PART_NUMBER_MCXA156VLL
```
